/* Copyright (c) 2012-2013, The Linux Foundation. All rights reserved.
 *
 * This program is free software; you can redistribute it and/or modify
 * it under the terms of the GNU General Public License version 2 and
 * only version 2 as published by the Free Software Foundation.
 *
 * This program is distributed in the hope that it will be useful,
 * but WITHOUT ANY WARRANTY; without even the implied warranty of
 * MERCHANTABILITY or FITNESS FOR A PARTICULAR PURPOSE.  See the
 * GNU General Public License for more details.
 */

/*---------------------------------------------------------------------------
 * This file is autogenerated file using gcdb parser. Please do not edit it.
 * Update input XML file to add a new entry or update variable in this file
 * VERSION = "1.0"
 *---------------------------------------------------------------------------*/
&mdss_mdp {
	dsi_r63311_jdi_1080_vid: qcom,mdss_dsi_r63311_jdi_1080p_video {
		qcom,mdss-dsi-panel-name = "r63311 jdi 1080p video mode dsi panel";
		qcom,cont-splash-enabled;
		qcom,mdss-dsi-panel-controller = <&mdss_dsi0>;
		qcom,mdss-dsi-panel-type = "dsi_video_mode";
		qcom,mdss-dsi-panel-destination = "display_1";
		qcom,mdss-dsi-panel-framerate = <60>;
		qcom,mdss-dsi-virtual-channel-id = <0>;
		qcom,mdss-dsi-stream = <0>;
		qcom,mdss-dsi-panel-width = <1080>;
		qcom,mdss-dsi-panel-height = <1920>;
		qcom,mdss-dsi-h-front-porch = <100>;
		qcom,mdss-dsi-h-back-porch = <100>;
		qcom,mdss-dsi-h-pulse-width = <50>;
		qcom,mdss-dsi-h-sync-skew = <0>;
		qcom,mdss-dsi-v-back-porch = <3>;
		qcom,mdss-dsi-v-front-porch = <3>;
		qcom,mdss-dsi-v-pulse-width = <2>;
		qcom,mdss-dsi-h-left-border = <0>;
		qcom,mdss-dsi-h-right-border = <0>;
		qcom,mdss-dsi-v-top-border = <0>;
		qcom,mdss-dsi-v-bottom-border = <0>;
		qcom,mdss-dsi-bpp = <24>;
		qcom,mdss-dsi-underflow-color = <0xff>;
		qcom,mdss-dsi-border-color = <0>;
		qcom,mdss-dsi-on-command = [29 01 00 00 00 00 02 b0 04
				05 01 00 00 00 00 02 00 00
				05 01 00 00 00 00 02 00 00
				29 01 00 00 00 00 19 c7 1c
    				22 26 28 33 46 37 4e 5e 6a 
    				70 7f 1c 22 26 28 33 43 37
    				4e 5e 6a 70 7f
				29 01 00 00 00 00 19 c8 08 
    				11 1a 21 2b 41 36 4c 5e 6a 
    				71 7f 08 11 1a 21 2b 41 36 
    				4c 5e 6a 71 7f
				29 01 00 00 00 00 19 c9 00
    				04 0c 18 27 40 36 4c 5c 68 
    				70 7f 00 04 0c 18 27 40 36
    				4c 5c 68 70 7f
				29 01 00 00 00 00 02 d6 01
				29 01 00 00 00 00 03 B6 3A D3 //modify LP clock to 20MHZ
				
				
				//39 01 00 00 00 00 03 51 0f ff
				//15 01 00 00 00 00 02 53 20
				15 01 00 00 00 00 02 55 03

				//39 01 00 00 00 00 03 5E 00 f0
				/* CE start */
				/* middle */
				29 01 00 00 00 00 21 CA 01 A5 83 85				    
    				88 82 8C 8C 08 
    				20 80 FF 0A 4A
    				37 A0 55 F8 0C
    				0C 10 10 10 10
    				00 00 10 10 3F
    				3F 3F 3F 
				/* CE end */
				
				29 01 00 00 00 00 08 ce 00 06 00 c1 90 a8 04 //PWM 17KHZ -> 10KHZ  dm->1s (a8 04->1s, bc 04->1.5s)
				
				05 01 00 00 24 00 02 29 00
				05 01 00 00 78 00 02 11 00];
		qcom,mdss-dsi-off-command = [05 01 00 00 24 00 02 28 00
				05 01 00 00 79 00 02 10 00];
		qcom,mdss-dsi-on-command-state = "dsi_lp_mode";
		qcom,mdss-dsi-off-command-state = "dsi_hs_mode";
		qcom,mdss-dsi-h-sync-pulse = <0>;
		qcom,mdss-dsi-traffic-mode = "burst_mode";
		qcom,mdss-dsi-bllp-eof-power-mode;
		qcom,mdss-dsi-bllp-power-mode;
		qcom,mdss-dsi-lane-0-state;
		qcom,mdss-dsi-lane-1-state;
		qcom,mdss-dsi-lane-2-state;
		qcom,mdss-dsi-lane-3-state;
		//qcom,mdss-dsi-panel-timings = [e7 36 24 00 66 6a 2a 3a 2d 03 04 00];
		//qcom,mdss-dsi-panel-timings = [e2 36 24 00 66 6a 28 38 2a 03 04 00];
		qcom,mdss-dsi-panel-timings = [F2 3A 28 00 6C 6E 2C 3E 2E 03 04 00];
		qcom,mdss-dsi-t-clk-post = <0x02>;//<0x04>;
		qcom,mdss-dsi-t-clk-pre = <0x2d>;//<0x1b>;
		qcom,mdss-dsi-bl-min-level = <1>;
		qcom,mdss-dsi-bl-max-level = <255>;
		qcom,mdss-dsi-dma-trigger = "trigger_sw";
		qcom,mdss-dsi-mdp-trigger = "none";
		qcom,mdss-dsi-bl-pmic-control-type = "bl_ctrl_dcs";
		qcom,mdss-dsi-reset-sequence = <1 5>, <0 10>, <1 10>;
		qcom,mdss-pan-physical-width-dimension = <61>;
		qcom,mdss-pan-physical-height-dimension = <110>;
		qcom,mdss-dsi-lp11-init; //add lp11_init
	};
};
