/* Copyright (c) 2012-2013, The Linux Foundation. All rights reserved.
 *
 * This program is free software; you can redistribute it and/or modify
 * it under the terms of the GNU General Public License version 2 and
 * only version 2 as published by the Free Software Foundation.
 *
 * This program is distributed in the hope that it will be useful,
 * but WITHOUT ANY WARRANTY; without even the implied warranty of
 * MERCHANTABILITY or FITNESS FOR A PARTICULAR PURPOSE.  See the
 * GNU General Public License for more details.
 */

/*---------------------------------------------------------------------------
 * This file is autogenerated file using gcdb parser. Please do not edit it.
 * Update input XML file to add a new entry or update variable in this file
 * VERSION = "1.0"
 *---------------------------------------------------------------------------*/
&mdss_mdp {
	dsi_sharp_1080_vid_r61322: qcom,mdss_dsi_r61322_sharp_1080p_video {
		qcom,mdss-dsi-panel-name = "sharp 1080p video mode dsi panel r61322";
		qcom,cont-splash-enabled;
		qcom,mdss-dsi-panel-controller = <&mdss_dsi0>;
		qcom,mdss-dsi-panel-type = "dsi_video_mode";
		qcom,mdss-dsi-panel-destination = "display_1";
		qcom,mdss-dsi-panel-framerate = <60>;
		qcom,mdss-dsi-virtual-channel-id = <0>;
		qcom,mdss-dsi-stream = <0>;
		qcom,mdss-dsi-panel-width = <1080>;
		qcom,mdss-dsi-panel-height = <1920>;
		qcom,mdss-dsi-h-front-porch = <216>;
		qcom,mdss-dsi-h-back-porch = <52>;
		qcom,mdss-dsi-h-pulse-width = <8>;
		qcom,mdss-dsi-h-sync-skew = <0>;
		qcom,mdss-dsi-v-back-porch = <5>;
		qcom,mdss-dsi-v-front-porch = <7>;
		qcom,mdss-dsi-v-pulse-width = <2>;
		qcom,mdss-dsi-h-left-border = <0>;
		qcom,mdss-dsi-h-right-border = <0>;
		qcom,mdss-dsi-v-top-border = <0>;
		qcom,mdss-dsi-v-bottom-border = <0>;
		qcom,mdss-dsi-bpp = <24>;
		qcom,mdss-dsi-color-order = "rgb_swap_rgb";
		qcom,mdss-dsi-underflow-color = <0x00>;
		qcom,mdss-dsi-border-color = <0>;
		qcom,mdss-dsi-on-command = [

				29 01 00 00 00 00 02 b0 04
	//			05 01 00 00 00 00 02 00 00
	//			05 01 00 00 00 00 02 00 00
				29 01 00 00 00 00 02 d6 01
				29 01 00 00 00 00 19 ce 76 40 48 56 67 78 88 98 a7 b5 c3 d1 de e9 f2 fa ff 0f 00 0a 07 46 04 00

	//			15 01 00 00 00 00 02 36 00
	//			29 01 00 00 00 00 08 ce 00 01 88 c1 00 1e 04
	
	//			15 01 00 00 00 00 02 51 00
				15 01 00 00 00 00 02 53 2C
				15 01 00 00 00 00 02 55 01
				05 01 00 00 14 00 02 29 00
				05 01 00 00 64 00 02 11 00
				//15 01 00 00 00 00 02 51 FF 
				//15 01 00 00 00 00 02 53 2C
				//15 01 00 00 00 00 02 55 01
				];
		qcom,mdss-dsi-off-command = [05 01 00 00 32 00 02 28 00
				05 01 00 00 78 00 02 10 00];
		qcom,mdss-dsi-ce-off-command = [29 01 00 00 00 00 21
							 CA 00 80 83 A5 C8 D2 DC DC 08 20 80 FF 0A 4A 37
							 A0 55 F8 0C 0C 20 10 3F 3F 00 00 10 10 3F 3F 3F 3F];
		qcom,mdss-dsi-ce-low-command = [29 01 00 00 00 00 21
							 CA 00 80 83 A5 C8 D2 DC DC 08 20 80 FF 0A 4A 37
							 A0 55 F8 0C 0C 20 10 3F 3F 00 00 10 10 3F 3F 3F 3F];
		qcom,mdss-dsi-ce-mid-command = [29 01 00 00 00 00 21
							 CA 01 80 83 83 C8 D2 83 83 08 20 80 FF 0A 4A 37
							 A0 55 F8 0C 0C 20 10 3F 3F 00 00 10 10 3F 3F 3F 3F];
		qcom,mdss-dsi-ce-high-command = [29 01 00 00 00 00 21
							 CA 01 a0 83 83 88 82 83 83 08 20 80 FF 0A 4A 37 A0
							 55 F8 0C 0C 20 10 3F 3F 00 00 10 10 3F 3F 3F 3F];	


		qcom,mdss-dsi-gamma-normal-command = [
			 29 01 00 00 00 00 19 c7 01	0a 11 1a 29 46 3d 4e 5b 64 6d 75 01 0a 11 1a 28 42 39 4c 59 63 6c 75
			 29 01 00 00 00 00 19 c8 01	0a 11 1a 29 46 3d 4e 5b 64 6d 75 01 0a 11 1a 28 42 39 4c 59 63 6c 75
			 29 01 00 00 00 00 19 c9 01	0a 11 1a 29 46 3d 4e 5b 64 6d 75 01 0a 11 1a 28 42 39 4c 59 63 6c 75 
		];
		qcom,mdss-dsi-gamma-cold-command = [
			 29  01 00 00 00 00 19  C7  2b 2e 30 34 3b 4c 3d 4f 5c 64 6b 75 2a 2c 2e 32 38 48 39 4d 5a 63 6a 75   
			 29  01 00 00 00 00 19  C8  1a 1e 21 27 31 47 3b 4d 5b 63 6a 75 1a 1e 21 26 30 43 37 4b 59 62 69 75
			 29  01 00 00 00 00 19  C9  01 09 0f 18 27 42 39 4c 59 62 6a 75 01 09 0f 18 26 3f 35 4a 57 61 69 75   
			];
		qcom,mdss-dsi-gamma-warm-command = [
			 29  01 00 00 00 00 19 C7   11 16 1a 21 2d 45 3a 4d 5a 63 6a 75 11 16 1a 20 2c 41 36 4a 58 62 69 75 
			 29  01 00 00 00 00 19 C8   01 09 0f 18 27 42 39 4c 59 62 6a 75 01 09 0f 18 26 3f 35 4a 57 61 69 75  
			 29  01 00 00 00 00 19 C9  11 16 1a 21 2d 45 3a 4d 5a 63 6a 75 11 16 1a 20 2c 41 36 4a 58 62 69 75   

		];

		
		qcom,mdss-dsi-on-command-state = "dsi_lp_mode";
		qcom,mdss-dsi-off-command-state = "dsi_hs_mode";
		qcom,mdss-dsi-ce-command-state = "dsi_lp_mode";
		qcom,mdss-dsi-h-sync-pulse = <1>;
		qcom,mdss-dsi-traffic-mode = "burst_mode";
		qcom,mdss-dsi-lane-map = <0>;
		qcom,mdss-dsi-bllp-eof-power-mode;
		qcom,mdss-dsi-bllp-power-mode;
		qcom,mdss-dsi-lane-0-state;
		qcom,mdss-dsi-lane-1-state;
		qcom,mdss-dsi-lane-2-state;
		qcom,mdss-dsi-lane-3-state;
		qcom,mdss-dsi-panel-timings = [F7 3a 28 00 6e 70 2c 3e 31 03 04 00];
		qcom,mdss-dsi-t-clk-post = <0x02>;
		qcom,mdss-dsi-t-clk-pre = <0x2d>;
		qcom,mdss-dsi-bl-min-level = <1>;
		qcom,mdss-dsi-bl-max-level = <255>;
		qcom,mdss-dsi-dma-trigger = "trigger_sw";
		qcom,mdss-dsi-mdp-trigger = "none";
		qcom,mdss-dsi-bl-pmic-control-type = "bl_ctrl_dcs";
		//qcom,mdss-dsi-pan-enable-dynamic-fps;
		//qcom,mdss-dsi-pan-fps-update = "dfps_suspend_resume_mode";
		qcom,mdss-dsi-reset-sequence = <0 4>, <0 10>, <1 4>;
	};
};
