/* Copyright (c) 2012-2013, The Linux Foundation. All rights reserved.
 *
 * This program is free software; you can redistribute it and/or modify
 * it under the terms of the GNU General Public License version 2 and
 * only version 2 as published by the Free Software Foundation.
 *
 * This program is distributed in the hope that it will be useful,
 * but WITHOUT ANY WARRANTY; without even the implied warranty of
 * MERCHANTABILITY or FITNESS FOR A PARTICULAR PURPOSE.  See the
 * GNU General Public License for more details.
 */

/*---------------------------------------------------------------------------
 * This file is autogenerated file using gcdb parser. Please do not edit it.
 * Update input XML file to add a new entry or update variable in this file
 * VERSION = "1.0"
 *---------------------------------------------------------------------------*/
&mdss_mdp {
	dsi_nt35596_tdi_1080_vid: qcom,mdss_dsi_nt35596_tdi_1080p_video {
		qcom,mdss-dsi-panel-name = "nt35596 tdi 1080p video mode dsi panel";
		qcom,cont-splash-enabled;
		qcom,mdss-dsi-panel-controller = <&mdss_dsi0>;
		qcom,mdss-dsi-panel-type = "dsi_video_mode";
		qcom,mdss-dsi-panel-destination = "display_1";
		qcom,mdss-dsi-panel-framerate = <60>;
		qcom,mdss-dsi-virtual-channel-id = <0>;
		qcom,mdss-dsi-stream = <0>;
		qcom,mdss-dsi-panel-width = <1080>;
		qcom,mdss-dsi-panel-height = <1920>;
		qcom,mdss-dsi-h-front-porch = <96>;
		qcom,mdss-dsi-h-back-porch = <42>;
		qcom,mdss-dsi-h-pulse-width = <3>;
		qcom,mdss-dsi-h-sync-skew = <0>;
		qcom,mdss-dsi-v-front-porch = <4>;
		qcom,mdss-dsi-v-back-porch = <3>;
		qcom,mdss-dsi-v-pulse-width = <1>;
		qcom,mdss-dsi-h-left-border = <0>;
		qcom,mdss-dsi-h-right-border = <0>;
		qcom,mdss-dsi-v-top-border = <0>;
		qcom,mdss-dsi-v-bottom-border = <0>;
		qcom,mdss-dsi-bpp = <24>;
		qcom,mdss-dsi-color-order = "rgb_swap_rgb";
		qcom,mdss-dsi-underflow-color = <0x00>;
		qcom,mdss-dsi-border-color = <0>;
		qcom,mdss-dsi-on-command = [
				15 01 00 00 00 00 02 FF 00
				15 01 00 00 00 00 02 FB 01
				15 01 00 00 00 00 02 D3 04
				15 01 00 00 00 00 02 D4 04
				15 01 00 00 00 00 02 53 2C
				15 01 00 00 00 00 02 55 02
				05 01 00 00 78 00 02 11 00
				05 01 00 00 00 00 02 29 00
			];			
		qcom,mdss-dsi-off-command = [
					05 01 00 00 32 00 02 28 00
					05 01 00 00 78 00 02 10 00];			
		qcom,mdss-dsi-ce-off-command = [
		15 01 00 00 00 00 02 FF 03
		15 01 00 00 00 00 02 FB 01
		15 01 00 00 00 00 02 FF 00
		15 01 00 00 00 00 02 55 02];
		qcom,mdss-dsi-ce-low-command = [
		15 01 00 00 00 00 02 FF 03
		15 01 00 00 00 00 02 FB 01
		15 01 00 00 00 00 02 FF 00
		15 01 00 00 00 00 02 55 02];
		qcom,mdss-dsi-ce-mid-command = [
		15 01 00 00 00 00 02 FF 03
		15 01 00 00 00 00 02 FB 01
		15 01 00 00 00 00 02 00 28
		15 01 00 00 00 00 02 01 30
		15 01 00 00 00 00 02 02 38
		15 01 00 00 00 00 02 03 40
		15 01 00 00 00 00 02 04 48
		15 01 00 00 00 00 02 05 50
		15 01 00 00 00 00 02 06 58
		15 01 00 00 00 00 02 07 60
		15 01 00 00 00 00 02 08 68
		15 01 00 00 00 00 02 09 70
		15 01 00 00 00 00 02 0A 78
		15 01 00 00 00 00 02 0B 80
		15 01 00 00 00 00 02 0C 80
		15 01 00 00 00 00 02 0D 70
		15 01 00 00 00 00 02 0E 60
		15 01 00 00 00 00 02 0F 50
		15 01 00 00 00 00 02 10 40
		15 01 00 00 00 00 02 11 30
		15 01 00 00 00 00 02 12 20
		15 01 00 00 00 00 02 13 10
		15 01 00 00 00 00 02 14 10
		15 01 00 00 00 00 02 15 18
		
		15 01 00 00 00 00 02 1A 77
		15 01 00 00 00 00 02 53 00
		15 01 00 00 00 00 02 5B 00
		15 01 00 00 00 00 02 63 00
		15 01 00 00 00 00 02 FF 00
		15 01 00 00 00 00 02 55 92];
		qcom,mdss-dsi-ce-high-command = [
		15 01 00 00 00 00 02 FF 03
		15 01 00 00 00 00 02 FB 01
		15 01 00 00 00 00 02 00 28
		15 01 00 00 00 00 02 01 2C
		15 01 00 00 00 00 02 02 30
		15 01 00 00 00 00 02 03 34
		15 01 00 00 00 00 02 04 38
		15 01 00 00 00 00 02 05 3C
		15 01 00 00 00 00 02 06 40
		15 01 00 00 00 00 02 07 48
		15 01 00 00 00 00 02 08 4C
		15 01 00 00 00 00 02 09 50
		15 01 00 00 00 00 02 0A 58
		15 01 00 00 00 00 02 0B 60
		15 01 00 00 00 00 02 0C 60
		15 01 00 00 00 00 02 0D 58
		15 01 00 00 00 00 02 0E 50
		15 01 00 00 00 00 02 0F 48
		15 01 00 00 00 00 02 10 38
		15 01 00 00 00 00 02 11 28
		15 01 00 00 00 00 02 12 28
		15 01 00 00 00 00 02 13 28
		15 01 00 00 00 00 02 14 10
		15 01 00 00 00 00 02 15 28
		
		15 01 00 00 00 00 02 1A 77
		15 01 00 00 00 00 02 53 00
		15 01 00 00 00 00 02 5B 00
		15 01 00 00 00 00 02 63 00
		15 01 00 00 00 00 02 FF 00
		15 01 00 00 00 00 02 55 92];					
		qcom,mdss-dsi-on-command-state = "dsi_lp_mode";
		qcom,mdss-dsi-off-command-state = "dsi_hs_mode";
		qcom,mdss-dsi-ce-command-state = "dsi_lp_mode";
		qcom,mdss-dsi-h-sync-pulse = <1>;
		qcom,mdss-dsi-traffic-mode = "burst_mode";
		qcom,mdss-dsi-lane-map = <0>;
		qcom,mdss-dsi-bllp-eof-power-mode;
		qcom,mdss-dsi-bllp-power-mode;
		qcom,mdss-dsi-lane-0-state;
		qcom,mdss-dsi-lane-1-state;
		qcom,mdss-dsi-lane-2-state;
		qcom,mdss-dsi-lane-3-state;
		qcom,mdss-dsi-panel-timings = [da 34 24 00 64 68 28 38 2a 03 04 00];
		qcom,mdss-dsi-t-clk-post = <0x03>;
		qcom,mdss-dsi-t-clk-pre = <0x29>;
		qcom,mdss-dsi-bl-min-level = <1>;
		qcom,mdss-dsi-bl-max-level = <255>;
		qcom,mdss-dsi-dma-trigger = "trigger_sw";
		qcom,mdss-dsi-mdp-trigger = "none";
		qcom,mdss-dsi-bl-pmic-control-type = "bl_ctrl_dcs";
		//qcom,mdss-dsi-pan-enable-dynamic-fps;
		//qcom,mdss-dsi-pan-fps-update = "dfps_suspend_resume_mode";
		qcom,mdss-dsi-reset-sequence = <0 4>, <0 10>, <1 4>;
	};
};
