/* Copyright (c) 2013-2014, The Linux Foundation. All rights reserved.
 *
 * This program is free software; you can redistribute it and/or modify
 * it under the terms of the GNU General Public License version 2 and
 * only version 2 as published by the Free Software Foundation.
 *
 * This program is distributed in the hope that it will be useful,
 * but WITHOUT ANY WARRANTY; without even the implied warranty of
 * MERCHANTABILITY or FITNESS FOR A PARTICULAR PURPOSE.  See the
 * GNU General Public License for more details.
 */

&mdss_mdp {
	dsi_samsung_1080p_cmd: qcom,mdss_dsi_samsung_1080p_cmd {
		qcom,mdss-dsi-panel-name = "samsung 1080p cmd mode dsi panel";
		qcom,mdss-dsi-panel-controller = <&mdss_dsi0>;
		qcom,mdss-dsi-panel-type = "dsi_cmd_mode";
		qcom,mdss-dsi-panel-destination = "display_1";
		qcom,mdss-dsi-panel-framerate = <60>;
		qcom,mdss-dsi-stream = <0>;
		qcom,mdss-dsi-panel-width = <1080>;
		qcom,mdss-dsi-panel-height = <1920>;
		qcom,mdss-dsi-h-front-porch = <100>;
		qcom,mdss-dsi-h-back-porch = <32>;
		qcom,mdss-dsi-h-pulse-width = <16>;
		qcom,mdss-dsi-h-sync-skew = <0>;
		qcom,mdss-dsi-v-back-porch = <16>;
		qcom,mdss-dsi-v-front-porch = <4>;
		qcom,mdss-dsi-v-pulse-width = <1>;	
		
	//	qcom,mdss-dsi-h-left-border = <0>;
	//	qcom,mdss-dsi-h-right-border = <0>;
	//	qcom,mdss-dsi-v-top-border = <0>;
	//	qcom,mdss-dsi-v-bottom-border = <0>;
		qcom,mdss-dsi-bpp = <24>;
		qcom,mdss-dsi-underflow-color = <0xff>;
		qcom,mdss-dsi-border-color = <0>;
		qcom,mdss-dsi-on-command = [05 01 00 00 46 00 01 11
				15 01 00 00 00 00 02 35 00
				29 01 00 00 00 00 03 f0 5a 5a
				15 01 00 00 00 00 02 b0 01
				15 01 00 00 00 00 02 b1 0d
				29 01 00 00 00 00 03 f0 a5 a5
				29 01 00 00 00 00 03 fc 5a 5a
				15 01 00 00 00 00 02 b0 1e
				15 01 00 00 00 00 02 fd a8
				29 01 00 00 00 00 03 fc a5 a5
				15 01 00 00 0000 02 53 20//28
				15 01 00 00 0000 02 55 00
				15 01 00 00 46 00 02 51 00
				05 01 00 00 00 00 01 29

					];
		qcom,mdss-dsi-off-command = [
				05 01 00 00 0a 00 01 10
				05 01 00 00 0a 00 01 28
		];
		qcom,mdss-dsi-acl-off-command = [
				15 01 00 00 0000 02 55 00
			];
		qcom,mdss-dsi-acl-on-command = [
				15 01 00 00 0000 02 55 02
			];		

		qcom,mdss-dsi-hbm-off-command = [
				15 01 00 00 0000 02 53 28
			];
		qcom,mdss-dsi-hbm-on-command = [
				15 01 00 00 0000 02 53 e0
			];



		qcom,mdss-dsi-on-command-state = "dsi_lp_mode";
		qcom,mdss-dsi-off-command-state = "dsi_hs_mode";
		qcom,mdss-dsi-acl-command-state = "dsi_lp_mode";
		qcom,mdss-dsi-h-sync-pulse = <0>;
		qcom,mdss-dsi-lp11-init;
		//qcom,mdss-dsi-init-delay-us=<10000>;
		qcom,mdss-dsi-traffic-mode = "non_burst_sync_event";
		qcom,mdss-dsi-bllp-eof-power-mode;
		qcom,mdss-dsi-bllp-power-mode;
		qcom,mdss-dsi-lane-0-state;
		qcom,mdss-dsi-lane-1-state;
		qcom,mdss-dsi-lane-2-state;
		qcom,mdss-dsi-lane-3-state;
		qcom,mdss-dsi-te-pin-select = <1>;
		qcom,mdss-dsi-wr-mem-start = <0x2c>;
		qcom,mdss-dsi-wr-mem-continue = <0x3c>;
		qcom,mdss-dsi-te-dcs-command = <1>;
		qcom,mdss-dsi-te-check-enable;
		qcom,mdss-dsi-te-using-te-pin;
		qcom,mdss-dsi-panel-timings = [  e2 36 24 00 66 6a 28 38 2a 03 04 00];
		qcom,mdss-dsi-t-clk-post = <0x2>;
		qcom,mdss-dsi-t-clk-pre = <0x2A>;
		qcom,mdss-dsi-bl-min-level = <1>;
		qcom,mdss-dsi-bl-max-level = <255>;
	//	qcom,mdss-dsi-bl-pmic-pwm-frequency = <100>;
	//	qcom,mdss-dsi-bl-pmic-bank-select = <7>;
		qcom,mdss-dsi-dma-trigger = "trigger_sw";
		qcom,mdss-dsi-mdp-trigger = "none";
		qcom,mdss-dsi-bl-pmic-control-type = "bl_ctrl_dcs";
		qcom,mdss-dsi-reset-sequence = <0 1>, <0 1>, <1 10>;

		qcom,mdss-pan-physical-width-dimension = <64>;
		qcom,mdss-pan-physical-height-dimension = <115>;
		
		//qcom,partial-update-enabled;
		qcom,esd-check-enabled;
	/*	qcom,mdss-dsi-panel-status-check-mode = "bta_check";*/

		

		qcom,mdss-dsi-panel-status-command = [06 01 00 01 05 00 02 0A 08];
		qcom,mdss-dsi-panel-status-command-state = "dsi_lp_mode";
		qcom,mdss-dsi-panel-status-check-mode = "reg_read_nt35596";
		qcom,mdss-dsi-panel-status-read-length = <8>;
		qcom,mdss-dsi-panel-max-error-count = <2>;
		qcom,mdss-dsi-panel-status-value = <0x8c 0x00 0x00 0x02 0x40 0x80 0x00 0x00>;
	};
};
